#define ZMK_POINTING_DEFAULT_MOVE_VAL 1200  // 600
#define ZMK_POINTING_DEFAULT_SCRL_VAL 25   // 10

#include <input/processors.dtsi>
#include <zephyr/dt-bindings/input/input-event-codes.h>
#include <behaviors.dtsi>
#include <dt-bindings/zmk/bt.h>
#include <dt-bindings/zmk/ext_power.h>
#include <dt-bindings/zmk/keys.h>
#include <dt-bindings/zmk/pointing.h>
#include <dt-bindings/zmk/rgb.h>
#include <dt-bindings/zmk/outputs.h>

// definizione layer
#define BASE 0
#define GAME 1
#define MIRROR 2
#define NUM 3
#define SYM 4
#define NAV 5
//#define NAV_MO 6
//#define NAV_TOG 7

// Meh key
//#define MEH LS(LC(LALT))

// Behaviors Constants
#define TAPPING_TERM_MS 280
#define QUICK_TAP_MS 175
#define REQUIRE_PRIOR_IDLE_MS 150

// Combos Constants
#define COMBO_TERM_DEFAULT 30
#define COMBO_QUICK_TAP_MS 100

/*
     LEFT        	     RIGHT       	JOYSTICK	ENCODER
  0  1  2  3  4  5	 7  8  9 10 11 12	    6
 13 14 15 16 17 18	20 21 22 23 24 25	19 32 45
 26 27 28 29 30 31	33 34 35 36 37 38	   58
 39 40 41 42 43 44	46 47 48 49 50 51
    53 54 55 56 57	59 60 61 62 63				52
*/

#define KEYS_L 0 1 2 3 4 5 13 14 15 16 17 18 26 27 28 29 30 31 39 40 41 42 43 44  // Left-hand keys.
#define KEYS_R 7 8 9 10 11 12 20 21 22 23 24 25 33 34 35 36 37 38 46 47 48 49 50 51  // Right-hand keys.
#define JOYSTICK 6 19 32 45 58
#define ENCODER 52
#define THUMBS 53 54 55 56 57 59 60 61 62 63


#include "mybehaviors.dtsi"
#include "macros.dtsi"
#include "combos.dtsi"

#include "layers.dtsi"

